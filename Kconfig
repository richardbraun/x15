## Kconfig
```kconfig
#
# For a description of the syntax of this configuration file,
# see doc/kbuild/kconfig-language.txt.
#
mainmenu "X15/$ARCH $VERSION Kernel Configuration"

config ARCH
	string
	option env="ARCH"

config VERSION
	string
	option env="VERSION"

config KERNEL_VERSION
	string
	default VERSION

config CC
	string
	option env="CC"

config CFLAGS
	string
	option env="CFLAGS"

menu "Build options"

config COMPILER
	string "Compiler executable"
	default CC
	---help---
	  Name of the compiler executable

	  This includes any toolchain prefix, and must be a file name,
	  not a path.

config COMPILER_OPTIONS
	string "Compilation options"
	default CFLAGS
	---help---
	  Raw options passed to the compiler.

config ASSERT
	bool "Assertions"
	default y
	---help---
	  Enable assert() code generation.

config SYMTAB
	bool "Build symbol table"
	default y
	---help---
	  Build and embed a symbol table in the kernel.

	  This option allows the kernel to perform symbolic address
	  resolutions which are very convenient for debugging, at the
	  cost of additional data memory.

	  If unsure, enable.

endmenu

source "arch/$ARCH/Kconfig"
source "kern/Kconfig"
source "test/Kconfig"
```

## arch/arm/Kconfig
```kconfig
menu "Architecture-specific options"

config ARM
	def_bool y

config ARMV7
	bool

config ARMV7A
	bool
	select ARMV7

config ARM_ARCH
	int
	default 7 if ARMV7

config SUBARCH
	string
	default "armv7a" if ARMV7A

config ARCH_SMP
	bool
	default y if ARMV7A

config CPU_CORTEX_A15
	bool
	select ARMV7A

choice
	prompt "Board"
	default BOARD_SELECT_QEMU_VIRT_2_8

config BOARD_SELECT_QEMU_VIRT_2_8
	bool "QEMU 2.8 virtual machine"
	---help---
	  This virtual board is used by the tools/qemu_arm.sh script.

endchoice

source "arch/arm/board-qemu-virt28/Kconfig"

endmenu
```

## arch/arm/board-qemu-virt28/Kconfig
```kconfig
if BOARD_SELECT_QEMU_VIRT_2_8

config BOARD_QEMU_VIRT_2_8
	def_bool y
	select ARMV7A

endif
```

## arch/x86/Kconfig
```kconfig
menu "Architecture-specific options"

config 64BITS
	bool "64-bits kernel" if ARCH = "x86"
	default ARCH != "i386"
	---help---
	  Build a 64-bits kernel.

config X86_PAE
	bool "Enable PAE (Physical Address Extension)"
	depends on X86_32
	---help---
	  PAE allows addressing physical memory beyond 4 GiB at the cost
	  of more pagetable lookup and memory overhead.

config X86_PMU_AMD
	bool "Enable AMD PMU driver"
	select PERFMON
	default n
	---help---
	  Enable support for the performance monitoring unit on AMD
	  processors.

	  If unsure, disable.

config X86_PMU_INTEL
	bool "Enable Intel PMU driver"
	select PERFMON
	default n
	---help---
	  Enable support for the performance monitoring unit on Intel
	  processors.

	  If unsure, disable.

endmenu

config X86_32
	def_bool y
	depends on !64BITS

config X86_64
	def_bool y
	depends on 64BITS

config X86
	def_bool y

config LATOMIC_REPLACE_ATOMIC_ON_UP
	def_bool y

config SUBARCH
	string
	default "i386" if X86_32
	default "amd64" if X86_64
```

## kern/Kconfig
```kconfig
menu "General setup"

config SMP
	bool "Multiprocessor support"
	default y
	---help---
	  Enable support for machines with multiple processors.

config MAX_CPUS
	int "Maximum number of supported CPUs" if SMP
	range 2 512 if SMP
	default "1" if !SMP
	default "128" if SMP
	---help---
	  Maximum number of supported processors.

config CLOCK_FREQ
	int "Low resolution clock frequency"
	range 100 1000
	default 200
	---help---
	  The low resolution clock frequency determines how often low
	  resolution clocks interrupt processors. These clocks drive
	  the timer system. Low values increase throughput and latencies,
	  whereas high values reduce throughput and latencies.

	  The value must be usable as an integer divisor for 1000, with
	  no remainder.

	  Recommended values are 100 for throughput, 1000 for low
	  latencies, and 200 or 250 for a good balance between throughput
	  and latencies.

choice
	prompt "Mutex implementation"
	default MUTEX_PLAIN
	---help---
	  A mutex is a sleeping synchronization object used throughout the
	  kernel and available to kernel applications. As a result, this
	  option affects all mutex users.

	  If in doubt, choose the plain implementation.

config MUTEX_ADAPTIVE
	bool "Adaptive spinning mutex"
	---help---
	  Adaptive spinning mutex, spinning instead of sleeping if the owner
	  is running, in the hope the critical section is short and the mutex
	  will be unlocked soon, to avoid expensive sleep/wakeup operations.
	  This implementation should improve overall performance at the cost
	  of increased latencies.

config MUTEX_PI
	bool "Mutex with priority inheritance"
	---help---
	  Real-time mutex with priority inheritance. This implementation
	  should improve latencies at the cost of overall performance.

config MUTEX_PLAIN
	bool "Plain mutex"
	---help---
	  Default implementation, immediately sleeping on contention.

endchoice

config RCU_WINDOW_CHECK_INTERVAL
	int "Interval between RCU window checks"
	range 1 100
	default 10
	---help---
	  Time (in milliseconds) between two RCU window checks.

	  The RCU system keeps memory used by read-side critical sections
	  until it is safe to release it, which can only be determined when
	  checking windows. As a result, checking windows more frequently
	  may help lower latencies on synchronous RCU waits, and in turn,
	  the amount of memory pending release, at the cost of increased
	  CPU overhead.

config SHELL
	bool "Embedded shell"
	default n
	---help---
	  Enable the embedded shell.

	  The embedded shell is mostly used for diagnostics.

config THREAD_STACK_GUARD
	bool "Thread stack guard pages"
	---help---
	  Enable the use of guard pages around kernel thread stacks to catch
	  overflows. Note that this feature wastes precious kernel virtual
	  memory and has some overhead during thread creation and destruction.

	  If unsure, disable.

config PERFMON
	def_bool n

config PERFMON_MAX_PMCS
	int "Number of performance monitoring counters"
	default 8
	depends on PERFMON
	---help---
	  Number of performance monitoring counters.

	  This value affects the minimum duration of some critical sections
	  that run with interrupts disabled.

endmenu

menu "Debugging"

config KMEM_DEBUG
	bool "Kernel allocator debugging"
	default n
	---help---
	  Enable the debugging of the kernel allocator.

config KMEM_NO_CPU_LAYER
	bool "Disable the CPU layer of the kernel allocator"
	depends on SMP
	default n
	---help---
	  The kernel allocator is made up of two layers named
	  the CPU and slab layers. the CPU layer is responsible
	  for caching objects locally on a processor to reduce
	  contention and cache misses. When reporting kernel
	  memory usage, the CPU layer is ignored, and objects
	  stored in it are accounted as allocated, which can
	  cause confusion when checking the state of the system.

	  This option disables the CPU layer entirely, so that
	  the report usage stats match the actual allocator
	  state.

	  If unsure, disable (leave the CPU layer enabled).

config INIT_DEBUG
	bool "Initialization debugging"
	default n
	---help---
	  Enable the debugging of initialization operations.

config MUTEX_DEBUG
	bool "Mutex debugging"
	default n
	---help---
	  Enable mutex debugging and instrumentation.

config SPINLOCK_DEBUG
	bool "Spinlock debugging"
	default n
	---help---
	  Enable spinlock ownership tracking.

endmenu
```

## test/Kconfig
```kconfig
menuconfig TEST_MODULE
	bool "Test module"
	default n
	---help---
	  Run a test module instead of booting the system.

if TEST_MODULE

choice
	prompt "Select test module"

config TEST_MODULE_ATOMIC
	bool "atomic"

if TEST_MODULE_ATOMIC

config TEST_MODULE_ATOMIC_64
	bool "Force 64-bit atomic operations"
	default n
	---help---
	  Force atomic operations to apply to 64-bit integers, even on 32-bit
	  targets. Some targets may not support 64-bit atomic operations
	  at all.

endif

config TEST_MODULE_BULLETIN
	bool "bulletin"

config TEST_MODULE_MUTEX
	bool "mutex"
	select MUTEX_DEBUG

config TEST_MODULE_MUTEX_PI
	bool "mutex_pi"

config TEST_MODULE_PERFMON_CPU
	bool "perfmon_cpu"
	depends on PERFMON

config TEST_MODULE_PERFMON_THREAD
	bool "perfmon_thread"
	depends on PERFMON

config TEST_MODULE_PERFMON_TORTURE
	bool "perfmon_torture"
	depends on PERFMON

config TEST_MODULE_PMAP_UPDATE_MP
	bool "pmap_update_mp"

config TEST_MODULE_RCU_DEFER
	bool "rcu_defer"

config TEST_MODULE_SREF_DIRTY_ZEROES
	bool "sref_dirty_zeroes"

config TEST_MODULE_SREF_NOREF
	bool "sref_noref"

config TEST_MODULE_SREF_WEAKREF
	bool "sref_weakref"

config TEST_MODULE_THREAD_SUSPEND
	bool "thread_suspend"

config TEST_MODULE_VM_PAGE_FILL
	bool "vm_page_fill"

config TEST_MODULE_XCALL
	bool "xcall"

endchoice

endif
```
